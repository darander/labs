## meta-lab-qemuarm/conf/layer.conf
```bitbake
# We have a conf and classes directory, add to BBPATH
BBPATH .= ":${LAYERDIR}"

# We have a recipes directory, add to BBFILES
BBFILES += "${LAYERDIR}/recipes-*/*/*.bb \
	${LAYERDIR}/recipes-*/*/*.bbappend"

BBFILE_COLLECTIONS += "lab-qemuarm"
BBFILE_PATTERN_lab-qemuarm = "^${LAYERDIR}/"
BBFILE_PRIORITY_lab-qemuarm = "6"
```

## meta-lab-qemuarm/conf/machine/lab-qemuarm.conf
```bitbake
#@TYPE: Machine
#@NAME: lab-qemuarm

#@DESCRIPTION: Machine configuration for lab-qemuarm systems


PREFERRED_PROVIDER_virtual/kernel ?= "linux-yocto"
PREFERRED_VERSION_linux-yocto ?= "3.8%"


require conf/machine/include/qemu.inc
require conf/machine/include/tune-arm926ejs.inc


# We bypass swrast but we need it to be present for X to load correctly
XSERVER ?= "xserver-xorg \
           mesa-driver-swrast \
           xf86-input-vmmouse \
           xf86-input-keyboard \
           xf86-input-evdev \
           xf86-video-vmware"

require conf/machine/include/qemu.inc

KERNEL_IMAGETYPE = "zImage"
SERIAL_CONSOLE = "115200 ttyAMA0"
```

## meta-lab1/conf/layer.conf
```bitbake
# We have a conf and classes directory, add to BBPATH
BBPATH .= ":${LAYERDIR}"

# We have a packages directory, add to BBFILES
BBFILES += "${LAYERDIR}/recipes-*/*/*.bb ${LAYERDIR}/recipes-*/*/*.bbappend"

BBFILE_COLLECTIONS += "lab1"
BBFILE_PATTERN_lab1 = "^${LAYERDIR}/"
BBFILE_PRIORITY_lab1 = "10"

# This should only be incremented on significant changes that will
# cause compatibility issues with other layers
LAYERVERSION_lab1 = "1"

LAYERDEPENDS_lab1 = "core"
```
